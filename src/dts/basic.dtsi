/* 
 * Make sure to add an include line to the system-top.dts file before
 * preprocessing the top level source file into system.dts and compiling
 * the device tree.
*/

/ {
	basic { compatible = "basic"; };
};

