/dts-v1/;

#include "zynq-7000.dtsi"
#include "pl.dtsi"
#include "pcw.dtsi"

/ {
	chosen {
		bootargs = "earlycon console=ttyPS0,115200";
		stdout-path = "serial0:115200n8";
	};
	aliases {
		ethernet0 = &gem0;
		serial0 = &uart1;
		spi0 = &qspi;
	};
	memory@0 {
		device_type = "memory";
		reg = <0x0 0x40000000>;
	};
};

